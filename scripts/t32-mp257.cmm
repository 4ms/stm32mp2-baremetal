// This script is intended to be run after TF-A has booted.
// TF-A should be just spinning, waiting for you to load a binary.

SYStem.CPU STM32MP257F-CA35

SYStem.config DEBUGPORTTYPE SWD 
SYStem.JtagClock 10MHz

Trace.DISable
SYStem.MemAccess DAP
SYStem.attach

Break

// Choose a project here:
//Data.LOAD.Elf ~/4ms/stm32/mp2-dev/stm32mp2-baremetal/ctest/build/main.elf /CPP
//Data.LOAD.Elf ~/4ms/stm32/mp2-dev/stm32mp2-baremetal/hal-dma/build/main.elf /CPP
//Data.LOAD.Elf ~/4ms/stm32/mp2-dev/stm32mp2-baremetal/interrupts/build/main.elf /CPP
//Data.LOAD.Elf ~/4ms/stm32/mp2-dev/stm32mp2-baremetal/multicore_smp/build/main.elf /CPP
//Data.LOAD.Elf ~/4ms/stm32/mp2-dev/stm32mp2-baremetal/i2c/build/main.elf /CPP
//Data.LOAD.Elf ~/4ms/stm32/mp2-dev/stm32mp2-baremetal/hal-audio/build/main.elf /CPP
//Data.LOAD.Elf ~/4ms/stm32/mp2-dev/stm32mp2-baremetal/usb-drd/build/main.elf /CPP
Data.LOAD.Elf ~/4ms/stm32/mp2-dev/stm32mp2-baremetal/gpu/build/main.elf /CPP

SYStem.JtagClock 50MHz

Trace.METHOD ONCHIP
ETM.Trace ON
ETM.ON

Trace.arm
system.Option DUALPORT on

// Set breakpoints or whether you want to auto-start here:

break main
go

ENDDO
